## zmk/zinc/Kconfig.shield
```kconfig
# Copyright (c) 2020 The ZMK Contributors
# SPDX-License-Identifier: MIT

config SHIELD_ZINC_LEFT
    def_bool $(shields_list_contains,zinc_left)

config SHIELD_ZINC_RIGHT
    def_bool $(shields_list_contains,zinc_right)
    
```
